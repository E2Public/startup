## defconfig
```kconfig
CONFIG_BOOTLOADER_LOG_LEVEL_ERROR=y
CONFIG_COMPILER_OPTIMIZATION_PERF=y
CONFIG_COMPILER_OPTIMIZATION_ASSERTIONS_DISABLE=y
CONFIG_ESP32_ULP_COPROC_ENABLED=y
CONFIG_ESP32_ULP_COPROC_RESERVE_MEM=1024
CONFIG_ESP32_BROWNOUT_DET_LVL_SEL_3=y
CONFIG_PM_ENABLE=y
# CONFIG_ESP_TASK_WDT is not set
CONFIG_FREERTOS_THREAD_LOCAL_STORAGE_POINTERS=2
CONFIG_FREERTOS_SUPPORT_STATIC_ALLOCATION=y
CONFIG_LOG_DEFAULT_LEVEL_WARN=y
CONFIG_WPA_TLS_V12=y
```
